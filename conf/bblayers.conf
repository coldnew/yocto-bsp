## conf/bblayers.conf
```bitbake
# LAYER_CONF_VERSION is increased each time build/conf/bblayers.conf
# changes incompatibly
LCONF_VERSION = "5"

BBPATH = "${TOPDIR}"
BSPDIR := "${@os.path.abspath(os.path.dirname(d.getVar('FILE', True)) + '/../..')}"

BBFILES ?= ""
BBLAYERS = " \
  ${BSPDIR}/sources/poky/meta \
  ${BSPDIR}/sources/poky/meta-yocto \
  ${BSPDIR}/sources/meta-openembedded/meta-oe \
  ${BSPDIR}/sources/meta-openembedded/meta-networking \
  ${BSPDIR}/sources/meta-openembedded/meta-ruby \
  ${BSPDIR}/sources/meta-openembedded/meta-python \
  \
  ${BSPDIR}/sources/meta-qt5 \
  \
  ${BSPDIR}/sources/meta-hydroid \
"
```

## conf/local.conf
```bitbake
#
# This is the default setting for coldnew's Yocto project
#
# For more setting, please see:
#
# https://www.yoctoproject.org/docs/latest/ref-manual/ref-manual.html
#

#
# Parallelism Options
#
# These two options control how much parallelism BitBake should use. The first
# option determines how many tasks bitbake should run in parallel:
#
BB_NUMBER_THREADS ?= "${@oe.utils.cpu_count()}"

#
# The second option controls how many processes make should run in parallel when
# running compile tasks:
#
# Default to setting automatically based on cpu count
PARALLEL_MAKE ?= "-j ${@oe.utils.cpu_count()}"

#
# For a quad-core machine, BB_NUMBER_THREADS = "4", PARALLEL_MAKE = "-j 4" would
# be appropriate for example.

#
# Where to place downloads
#
# During a first build the system will download many different source code tarballs
# from various upstream projects. This can take a while, particularly if your network
# connection is slow. These are all stored in DL_DIR. When wiping and rebuilding you
# can preserve this directory to speed up this part of subsequent builds. This directory
# is safe to share between multiple builds on the same machine too.
#
# The default is a downloads directory under TOPDIR which is the build directory.
#
DL_DIR ?= "${BSPDIR}/downloads"

#
# Where to place shared-state files
#
# BitBake has the capability to accelerate builds based on previously built output.
# This is done using "shared state" files which can be thought of as cache objects
# and this option determines where those files are placed.
#
# You can wipe out TMPDIR leaving this directory intact and the build would regenerate
# from these files if no changes were made to the configuration. If changes were made
# to the configuration, only shared state files where the state was still valid would
# be used (done using checksums).
#
# The default is a sstate-cache directory under TOPDIR.
#
SSTATE_DIR ?= "${BSPDIR}/sstate-cache"

#
# Where to place the build output
#
# This option specifies where the bulk of the building work should be done and
# where BitBake should place its temporary files and output. Keep in mind that
# this includes the extraction and compilation of many applications and the toolchain
# which can use Gigabytes of hard disk space.
#
# The default is a tmp directory under TOPDIR.
#
#TMPDIR = "${TOPDIR}/tmp"

#
# Where to place deploy files
#
# Points to the general area that the OpenEmbedded build system uses to
# place images, packages, SDKs, and other output files that are ready to
# be used outside of the build system. By default, this directory
# resides within the Build Directory as ${TMPDIR}/deploy
#
DEPLOY_DIR ?= "${BSPDIR}/deploy/"

#
# Buildhistory
#
# Build history is disabled by default. To enable it, add the
# following INHERIT statement and set the BUILDHISTORY_COMMIT variable
# to "1" at the end of your conf/local.conf file found in the Build
# Directory:
#
# NOTE:
# Enabling build history increases your build times slightly,
# particularly for images, and increases the amount of disk space used
# during the build.
#
INHERIT += "buildhistory"
BUILDHISTORY_COMMIT = "1"
BUILDHISTORY_DIR = "${DEPLOY_DIR}/buildhistory"

# Package Management configuration
#
# This variable lists which packaging formats to enable. Multiple package backends
# can be enabled at once and the first item listed in the variable will be used
# to generate the root filesystems.
# Options are:
#  - 'package_deb' for debian style deb files
#  - 'package_ipk' for ipk files are used by opkg (a debian style embedded package manager)
#  - 'package_rpm' for rpm style packages
#  - 'package_tar' for tar.gz style package
#
# E.g.: PACKAGE_CLASSES ?= "package_rpm package_deb package_ipk"
#
PACKAGE_CLASSES ?= "package_ipk"

# Uncomment this to delete work files as the build progresses rather than
# keeping them around, which saves a lot of disk space. However, if any
# problems arise it can be useful to have the work files to examine, which
# is why it is off by default.
#
INHERIT += "rm_work"

#
# Qemu configuration
#
# By default qemu will build with a builtin VNC server where graphical output can be
# seen. The two lines below enable the SDL backend too. This assumes there is a
# libsdl library available on your build system.
#
PACKAGECONFIG_pn-qemu-native = "sdl"
PACKAGECONFIG_pn-nativesdk-qemu = "sdl"
ASSUME_PROVIDED += "libsdl-native"

#
# IMAGE_FEATURES
#
# https://www.yoctoproject.org/docs/2.8/ref-manual/ref-manual.html#var-IMAGE_FEATURES
#
# The contents of images generated by the OpenEmbedded build system can
# be controlled by the IMAGE_FEATURES and EXTRA_IMAGE_FEATURES variables
# that you typically configure in your image recipes. Through these
# variables, you can add several different predefined packages such as
# development utilities or packages with debug information needed to
# investigate application problems or profile applications.
#
# allow-empty-password: Allows Dropbear and OpenSSH to accept root
#                       logins and logins from accounts having an
#                       empty password string.
#
# dbg-pkgs: Installs debug symbol packages for all packages installed
#           in a given image.
#
# debug-tweaks: Makes an image suitable for development (e.g. allows
#               root logins without passwords and enables
#               post-installation logging). See the
#               'allow-empty-password', 'empty-root-password', and
#               'post-install-logging' features in this list for
#               additional information.
#
# dev-pkgs: Installs development packages (headers and extra library
#           links) for all packages installed in a given image.
#
# doc-pkgs: Installs documentation packages for all packages installed
#           in a given image.
#
# empty-root-password: Sets the root password to an empty string,
#                      which allows logins with a blank password.
#
# package-management: Installs package management tools and preserves
#                     the package manager database.
#
# post-install-logging: Enables logging postinstall script runs to the
#                       /var/log/postinstall.log file on first boot of
#                       the image on the target system.
#
# ptest-pkgs: Installs ptest packages for all ptest-enabled recipes.
#
# read-only-rootfs: Creates an image whose root filesystem is
#                   read-only. See the "Creating a Read-Only Root
#                   Filesystem" section in the Yocto Project
#                   Development Tasks Manual for more information.
#
# splash: Enables showing a splash screen during boot. By default,
#         this screen is provided by psplash, which does allow
#         customization. If you prefer to use an alternative splash
#         screen package, you can do so by setting the SPLASH variable
#         to a different package name (or names) within the image
#         recipe or at the distro configuration level.
#
# staticdev-pkgs: Installs static development packages, which are
#                 static libraries (i.e. *.a files), for all packages
#                 installed in a given image.
#
#
# Some image features are available only when you inherit the
# core-image class. The current list of these valid features is as
# follows:
#
# hwcodecs: Installs hardware acceleration codecs.
#
# nfs-server: Installs an NFS server.
#
# perf: Installs profiling tools such as perf, systemtap, and
#       LTTng. For general information on user-space tools, see the
#       Yocto Project Application Development and the Extensible
#       Software Development Kit (eSDK) manual.
#
# ssh-server-dropbear: Installs the Dropbear minimal SSH server.
#
# ssh-server-openssh: Installs the OpenSSH SSH server, which is more
#                     full-featured than Dropbear. Note that if both
#                     the OpenSSH SSH server and the Dropbear minimal
#                     SSH server are present in IMAGE_FEATURES, then
#                     OpenSSH will take precedence and Dropbear will
#                     not be installed.
#
# tools-debug: Installs debugging tools such as strace and gdb. For
#              information on GDB, see the "Debugging With the GNU
#              Project Debugger (GDB) Remotely" section in the Yocto
#              Project Development Tasks Manual. For information on
#              tracing and profiling, see the Yocto Project Profiling
#              and Tracing Manual.
#
# tools-sdk: Installs a full SDK that runs on the device.
#
# tools-testapps: Installs device testing tools (e.g. touchscreen
#                 debugging).
#
# x11: Installs the X server.
#
# x11-base: Installs the X server with a minimal environment.
#
# x11-sato: Installs the OpenedHand Sato environment.
#
IMAGE_FEATURES ?= "ssh-server-openssh package-management"

#
# EXTRA_IMAGE_FEATURES
#
# https://www.yoctoproject.org/docs/latest/ref-manual/ref-manual.html#var-EXTRA_IMAGE_FEATURES
#
# The list of additional features to include in an image. Typically,
# you configure this variable in your local.conf file, which is found in
# the Build Directory. Although you can use this variable from within a
# recipe, best practices dictate that you do not.
#
# "dbg-pkgs" - Adds -dbg packages for all installed packages
#              including symbol information for debugging and
#              profiling.
#
# "debug-tweaks" - Makes an image suitable for development.
#                  For example, ssh root access has a blank
#                  password.  You should remove this feature
#                  before you produce a production image.
#
# "dev-pkgs" - Adds -dev packages for all installed packages.
#              This is useful if you want to develop against
#              the libraries in the image.
#
# "read-only-rootfs" - Creates an image whose root
#                      filesystem is read-only. See the
#                      "Creating a Read-Only Root Filesystem"
#                      section in the Yocto Project
#                      Development Manual for more
#                      information
#
# "tools-debug" - Adds debugging tools such as gdb and
#                 strace.
#
# "tools-profile" - Adds profiling tools such as oprofile,
#                   exmap, lttng and valgrind (x86 only).
#
# "tools-sdk" - Adds development tools such as gcc, make,
#               pkgconfig and so forth.
#
# "tools-testapps" - Adds useful testing tools such as
#                    ts_print, aplay, arecord and so
#                    forth.
#
EXTRA_IMAGE_FEATURES ?= "debug-tweaks tools-debug tools-profile tools-sdk"


#
# Default policy config
#
# The distribution setting controls which policy settings are used as defaults.
# The default value is fine for general Yocto project use, at least initially.
# Ultimately when creating custom policy, people will likely end up subclassing
# these defaults.
#
DISTRO ?= "poky"

#
# SDK/ADT target architecture
#
# This variable specifies the architecture to build SDK/ADT items for and means
# you can build the SDK packages for architectures other than the machine you are
# running the build on (i.e. building i686 packages on an x86_64 host).
# Supported values are i686 and x86_64
#
SDKMACHINE ?= "x86_64"
```

## sources/coldnew-layers/meta-coldnew/conf/layer.conf
```bitbake
# We have a conf and classes directory, add to BBPATH
BBPATH .= ":${LAYERDIR}"

# We have recipes-* directories, add to BBFILES
BBFILES += "${LAYERDIR}/recipes-*/*/*.bb \
            ${LAYERDIR}/recipes-*/*/*.bbappend"

BBFILE_COLLECTIONS += "coldnew"
BBFILE_PATTERN_coldnew = "^${LAYERDIR}/"
BBFILE_PRIORITY_coldnew = "6"

LAYERDEPENDS_coldnew = "core"
LAYERSERIES_COMPAT_coldnew = "warrior"

BBFILES_DYNAMIC += " \
    qt5.6-layer:${LAYERDIR}/dynamic-layers/qt5.6-layer/*/*/*.bb \
    qt5.6-layer:${LAYERDIR}/dynamic-layers/qt5.6-layer/*/*/*.bbappend \
"
```

## sources/coldnew-layers/meta-coldnew/wic/qemux86-vmdk.wks
```
# short-description: Create a qemu machine 'pcbios' direct disk image
# long-description: Creates a partitioned legacy BIOS disk image that the user
# can directly use to boot a qemu machine.

# This file is included into 3 canned wks files from this directory
part /boot --source bootimg-pcbios --ondisk vda --label boot --active --align 1024
part / --source rootfs --use-uuid --fstype=ext4 --label platform --align 1024

#bootloader  --timeout=0  --append="oprofile.timer=1 rootfstype=ext4 net.ifnames=0 biosdevname=0 root=/dev/vda2 rw"

bootloader  --timeout=0  --append="root=/dev/vda2 rw  console=ttyS0 net.ifnames=0 biosdevname=0"
```
